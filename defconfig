## defconfig
```kconfig
CONFIG_AUTOSTART_ARDUINO=y
CONFIG_ARDUHAL_LOG_DEFAULT_LEVEL_DEBUG=y
CONFIG_ARDUHAL_LOG_COLORS=y
CONFIG_BT_ENABLED=y
CONFIG_BT_NIMBLE_ENABLED=y
CONFIG_ESP_MAIN_TASK_STACK_SIZE=7000
CONFIG_FREERTOS_HZ=1000
```

## sdkconfig.defaults
```kconfig
CONFIG_PARTITION_TABLE_SINGLE_APP_LARGE=y
CONFIG_ARDUINO_SELECTIVE_COMPILATION=y
CONFIG_ESP_MAIN_TASK_STACK_SIZE=7000
CONFIG_FREERTOS_HZ=1000

CONFIG_BT_BLUEDROID_ENABLED=n

CONFIG_BT_BLE_CCA_MODE_HW=y
CONFIG_BT_BLE_ENABLED=y
CONFIG_BT_ENABLED=y

CONFIG_BT_CTRL_DFT_TX_POWER_LEVEL_P21=y

CONFIG_BT_NIMBLE_SVC_GAP_DEVICE_NAME="u701"
CONFIG_BT_NIMBLE_HOST_BASED_PRIVACY=y
CONFIG_BT_NIMBLE_HIGH_DUTY_ADV_ITVL=y
CONFIG_BT_NIMBLE_MAX_CONNECTIONS=9
CONFIG_BT_NIMBLE_HS_FLOW_CTRL=y
CONFIG_BT_NIMBLE_RPA_TIMEOUT=30
CONFIG_BT_NIMBLE_MAX_BONDS=9
CONFIG_BT_NIMBLE_MAX_CCCDS=9
CONFIG_BT_NIMBLE_ENABLED=y

CONFIG_BTDM_CTRL_MODE_BR_EDR_ONLY=n
CONFIG_BTDM_CTRL_MODE_BLE_ONLY=y
CONFIG_BTDM_CTRL_MODE_BTDM=n

CONFIG_ESP_TASK_WDT_PANIC=y
CONFIG_BTDM_CONTROLLER_MODEM_SLEEP=n
```

## sdkconfig.defaults.debug
```kconfig
CONFIG_ESP_TIMER_SUPPORTS_ISR_DISPATCH_METHOD=y
CONFIG_ARDUHAL_LOG_DEFAULT_LEVEL_DEBUG=y
CONFIG_BT_NIMBLE_LOG_LEVEL_DEBUG=y
CONFIG_ESP_TASK_WDT_TIMEOUT_S=60
CONFIG_ESP_TIMER_PROFILING=y
CONFIG_ARDUHAL_LOG_COLORS=y
CONFIG_ARDUHAL_ESP_LOG=y

# Detailed Logging for Specific Components
CONFIG_LOG_VERBOSE=y

# Memory Leak Detection and Management
CONFIG_HEAP_POISONING_COMPREHENSIVE=y
CONFIG_HEAP_TRACING=y

# GDBStub for On-Device Debugging
CONFIG_ESP32_ENABLE_COREDUMP_TO_UART=y
CONFIG_ESP_GDBSTUB_ENABLE=y

# Task and Stack Monitoring
CONFIG_FREERTOS_CHECK_STACKOVERFLOW_CANARY=y
CONFIG_FREERTOS_CHECK_MUTEX_GIVEN_BY_OWNER=y

# Asserts
CONFIG_ASSERT=y

# Performance Counters
CONFIG_PERFMON_ENABLE=y
```

## sdkconfig.defaults.release
```kconfig
CONFIG_ESP_COREDUMP_ENABLE_TO_FLASH=y
CONFIG_NEWLIB_NANO_FORMAT=y

CONFIG_ARDUHAL_LOG_DEFAULT_LEVEL_INFO=y
CONFIG_BT_NIMBLE_LOG_LEVEL_WARNING=y

# Optimized Compiler Settings
CONFIG_COMPILER_OPTIMIZATION_ASSERTIONS_DISABLE=y
CONFIG_COMPILER_STACK_CHECK_MODE_NORM=y
CONFIG_COMPILER_DISABLE_GCC8_WARNINGS=y
CONFIG_COMPILER_OPTIMIZATION_PERF=y
CONFIG_COMPILER_OPTIMIZATION_SIZE=y

# Security and Encryption
CONFIG_MBEDTLS_SSL_RENEGOTIATION=n
CONFIG_MBEDTLS_ECP_RESTARTABLE=y
CONFIG_MBEDTLS_HARDWARE_AES=y
CONFIG_MBEDTLS_CMAC_C=y

# Memory and Resource Management
CONFIG_HEAP_POISONING_DISABLED=y
CONFIG_FREERTOS_UNICORE=y

# Disable Debugging and Profiling Tools
CONFIG_ESP32_DEBUG_OCDAWARE=n
CONFIG_ESP_TIMER_PROFILING=n

# Power Management
CONFIG_FREERTOS_USE_TICKLESS_IDLE=n
CONFIG_PM_ENABLE=n

# File System and Storage
CONFIG_FATFS_CODEPAGE_437=y
CONFIG_WL_SECTOR_SIZE_4096=y

# Miscellaneous
CONFIG_BTDM_CONTROLLER_FULL_SCAN_SUPPORTED=n
CONFIG_ESP32_DEFAULT_PTHREAD_CORE_NO_AFFINITY=y
```
